#include <SoftwareSerial.h>
#include <ELMduino.h>
#include <SPI.h>
#include <Wire.h>
#include <Adafruit_GFX.h>
#include <Adafruit_SSD1306.h>
#include <Adafruit_BMP085_U.h>
#include <Adafruit_BMP085.h>

#define RX 3
#define TX 2

//Adafruit_BMP085_Unified bmp;
Adafruit_BMP085 bmp;

float pressurePa;
float temperature;
int mapsen = 0; 
float boost = 0; 
float boostplus;
float boostminus;
float boostavg;
float mapval = 0; 
//float atmpsi = 14.7;

char c = ' ';
boolean new_line = true;

#define SCREEN_WIDTH 128  // OLED display width, in pixels
#define SCREEN_HEIGHT 64  // OLED display height, in pixels
#define OLED_RESET -1        // Reset pin # (or -1 if sharing Arduino reset pin)
#define SCREEN_ADDRESS 0x3C  ///< See datasheet for Address; 0x3D for 128x64, 0x3C for 128x32
Adafruit_SSD1306 display(SCREEN_WIDTH, SCREEN_HEIGHT, &Wire, OLED_RESET);


#define LOGO_HEIGHT 16
#define LOGO_WIDTH 16
// 'd48al2k-b07be41a-d8a2-49b5-a2ca-872a4708fcac', 128x64px
//Volkswagen Startup Logo
const unsigned char myBitmap[] PROGMEM = {
  0xff, 0xff, 0xff, 0xff, 0xff, 0xff, 0xff, 0xc0, 0x03, 0xff, 0xff, 0xff, 0xff, 0xff, 0xff, 0xff,
  0xff, 0xff, 0xff, 0xff, 0xff, 0xff, 0xfc, 0x38, 0x3c, 0x3f, 0xff, 0xff, 0xff, 0xff, 0xff, 0xff,
  0xff, 0xff, 0xff, 0xff, 0xff, 0xff, 0xe3, 0x00, 0x00, 0xc7, 0xff, 0xff, 0xff, 0xff, 0xff, 0xff,
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  0xff, 0xff, 0xff, 0xff, 0xff, 0xff, 0xff, 0xfc, 0x3f, 0xff, 0xff, 0xff, 0xff, 0xff, 0xff, 0xff
};

  void setup() {

    // Start Serial Monitor for feedback
    Serial.begin(9600);

    Serial.println("Enter AT commands:");

    // SSD1306_SWITCHCAPVCC = generate display voltage from 3.3V internally
    if (!display.begin(SSD1306_SWITCHCAPVCC, SCREEN_ADDRESS)) {
      //display.clearDisplay();
      //delay(2000);
      Serial.println(F("SSD1306 allocation failed"));
      for (;;)
        ;  // Don't proceed, loop forever
    }
    if (!bmp.begin()) {
      Serial.print("Couldn't find the sensor");
      while (1);
    }

    //startup screen message display
    display.drawBitmap(0, 0, myBitmap, 128, 64, SSD1306_WHITE);
    display.display();
    delay(3000);
    display.clearDisplay();      
    display.setTextSize(2);      
    display.setTextColor(WHITE); 
    display.setCursor(10, 20);   
    display.println("Welcome");  
    display.setCursor(30, 40);   
    display.println("Oliver");   
    display.display();    
    display.clearDisplay();
    delay(3000);
    display.setTextSize(1.5);
    display.setCursor(25, 0);
    display.println("Boost Pressure");
  }

  void loop() {
    //read pressure in Pa and convert to kPa
    float pressurePa = (bmp.readPressure() / 1000);
    //read tempearture in C and convert to F
    float temperature = (bmp.readTemperature() * 1.8 + 32);
    //manufacturer transfer equation for pressure gauge
    //Vout = VS*(0.0012858*P+0.04) ± Error 
    mapval= analogRead(mapsen); //Reads the MAP sensor raw value on analog port 0
    //transfer equation from kPa to psi
    boost=(((((((float)mapval/(float)1023) - 0.04)/0.0012858) - pressurePa) * .145038) );
    //account for error correction with pressure gauge 
    boostplus = ((((((float)mapval/(float)1023) - 0.04)/0.0012858) - pressurePa) * .145038) + (boost * .025); 
    boostminus = ((((((float)mapval/(float)1023) - 0.04)/0.0012858) - pressurePa) * .145038) - (boost * .025); 
    boostavg = (((boostplus + boostminus) / 2)+.64); //add .64 to achive proper ambient air pressure value. 
    if(boostavg<=0){
      boostavg=0;
    }
    else{
    //display boost value and temperature value 
    display.clearDisplay();
    display.setTextSize(2);
    display.setCursor(5, 10);
    display.print(boostavg,2);
    display.print(" PSI");
    display.setCursor(15,40);
    display.print(temperature);
    display.print(" F");
    display.display();
  }
}
